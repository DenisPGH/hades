## src/drivers/differential_pressure/ASP5033Driver/Kconfig
```kconfig
menuconfig DRIVERS_DIFFERENTIAL_PRESSURE_ASP5033Driver
	bool "asp5033driver"
	default n
	---help---
		Enable support for asp5033driver
```

## src/examples/deni/Kconfig
```kconfig
menuconfig EXAMPLES_DENI
	bool "deni"
	default n
	---help---
		Enable support for deni
```

## src/modules/asp5033/Kconfig
```kconfig
menuconfig MODULES_ASP5033
	bool "asp5033"
	default n
	---help---
		Enable support for asp5033

menuconfig USER_ASP5033
	bool "asp5033 running as userspace module"
	default y
	depends on BOARD_PROTECTED && MODULES_ASP5033
	---help---
		Put asp5033 in userspace memory
```

## src/modules/aspdeni/Kconfig
```kconfig
menuconfig MODULES_ASPDENI
	bool "aspdeni"
	default n
	---help---
		Enable support for aspdeni

menuconfig USER_ASPDENI
	bool "aspdeni running as userspace module"
	default y
	depends on BOARD_PROTECTED && MODULES_ASPDENI
	---help---
		Put aspdeni in userspace memory
```
